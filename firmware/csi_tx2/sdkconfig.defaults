## firmware/hinigram_universal_node/main/Kconfig.projbuild
```kconfig
menu "Hinigram universal node"
    config HINIGRAM_CHANNEL
        int "Wi-Fi channel (must match the receiver)"
        range 1 13
        default 6
    config HINIGRAM_SEND_HZ
        int "Packets per second"
        range 5 100
        default 30
endmenu
```

## notebooks/research/hinigram-v1.3.3/firmware/hinigram_node/main/Kconfig.projbuild
```kconfig
menu "Hinigram chair node"
    config HINIGRAM_NODE_ID
        int "Node ID (1 to 254); the node sends from 1a:00:00:00:00:<ID in hex>"
        range 1 254
        default 1
    config HINIGRAM_CHANNEL
        int "Wi-Fi channel (must match the receivers)"
        range 1 13
        default 6
    config HINIGRAM_SEND_HZ
        int "Packets per second"
        range 5 100
        default 30
endmenu
```

## notebooks/research/hinigram-v1.3.3/firmware/hinigram_node/sdkconfig.defaults
```kconfig
CONFIG_IDF_TARGET="esp32"
CONFIG_ESP_WIFI_DYNAMIC_TX_BUFFER_NUM=128
CONFIG_ESP_WIFI_AMPDU_TX_ENABLED=n
CONFIG_FREERTOS_HZ=1000
CONFIG_LOG_DEFAULT_LEVEL_WARN=y
```

## notebooks/research/hinigram-v1.3.3/firmware/hinigram_receiver/main/Kconfig.projbuild
```kconfig
menu "Hinigram corner receiver"
    config HINIGRAM_RECEIVER_ID
        int "Receiver ID (printed in the HINIGRAM_RX status line)"
        range 1 9
        default 1
    config HINIGRAM_CHANNEL
        int "Wi-Fi channel (must match the nodes)"
        range 1 13
        default 6
    config HINIGRAM_NODE_FIRST
        int "First node ID this receiver logs"
        range 1 254
        default 1
    config HINIGRAM_NODE_LAST
        int "Last node ID this receiver logs"
        range 1 254
        default 254
endmenu
```
